## conf/layer.conf
```bitbake
# We have a conf and classes directory, add to BBPATH
BBPATH .= ":${LAYERDIR}"

# We have recipes-* directories, add to BBFILES
BBFILES += "${LAYERDIR}/recipes-*/*/*.bb \
            ${LAYERDIR}/recipes-*/*/*.bbappend"

BBFILE_COLLECTIONS += "meta-adlink-eiq-genai-flow"
BBFILE_PATTERN_meta-adlink-eiq-genai-flow = "^${LAYERDIR}/"
BBFILE_PRIORITY_meta-adlink-eiq-genai-flow = "6"

LAYERDEPENDS_meta-adlink-eiq-genai-flow = "core"
LAYERSERIES_COMPAT_meta-adlink-eiq-genai-flow = "scarthgap"
```
